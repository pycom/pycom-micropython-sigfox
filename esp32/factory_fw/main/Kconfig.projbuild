## esp32/factory_fw/main/Kconfig.projbuild
```kconfig
menu "Pycom Factory FW Config"

    config PYCOM_SW_SERVER
        string "Software Server Address"
        default "software.pycom.io"
        help
            Address of the Software Server to request OTA Updates

    config PYCOM_SW_SERVER_PORT
        string "Software Server Port"
        default "443"
        help
            Port of the Software Server to request OTA Updates

endmenu
```

## esp32/factory_fw/sdkconfig.defaults
```kconfig
# Changes for Custom Partition Table
CONFIG_ESPTOOLPY_FLASHSIZE_8MB=y
CONFIG_ESPTOOLPY_FLASHSIZE="8MB"
CONFIG_PARTITION_TABLE_CUSTOM=y
CONFIG_PARTITION_TABLE_CUSTOM_FILENAME="partitions_8MB.csv"
CONFIG_PARTITION_TABLE_FILENAME="partitions_8MB.csv"
CONFIG_ESP_TASK_WDT_TIMEOUT_S=10

CONFIG_COMPILER_OPTIMIZATION_LEVEL_RELEASE=y
CONFIG_COMPILER_OPTIMIZATION_ASSERTIONS_ENABLE=y

CONFIG_LOG_DEFAULT_LEVEL_NONE=y
CONFIG_LOG_DEFAULT_LEVEL=0

# To avoid Factory FW Boot Crash
CONFIG_SPI_FLASH_USE_LEGACY_IMPL=y

# To avoid make failure
FREERTOS_ENABLE_STATIC_TASK_CLEAN_UP=n

# BOOTLOADER CONFIG
CONFIG_BOOTLOADER_LOG_LEVEL_NONE=y
CONFIG_BOOTLOADER_LOG_LEVEL=0

CONFIG_APP_EXCLUDE_PROJECT_VER_VAR=y
CONFIG_APP_EXCLUDE_PROJECT_NAME_VAR=y

CONFIG_ESP32_SPIRAM_SUPPORT=y
CONFIG_SPIRAM_BOOT_INIT=y
CONFIG_SPIRAM_IGNORE_NOTFOUND=y
# CONFIG_SPIRAM_USE_MEMMAP is not set
# CONFIG_SPIRAM_USE_CAPS_ALLOC is not set
CONFIG_SPIRAM_USE_MALLOC=y
CONFIG_SPIRAM_TYPE_AUTO=y
# CONFIG_SPIRAM_TYPE_ESPPSRAM32 is not set
# CONFIG_SPIRAM_TYPE_ESPPSRAM64 is not set
CONFIG_SPIRAM_SIZE=-1
CONFIG_SPIRAM_SPEED_40M=y
# CONFIG_SPIRAM_SPEED_80M is not set
# CONFIG_SPIRAM_MEMTEST is not set
CONFIG_SPIRAM_CACHE_WORKAROUND=y
# CONFIG_SPIRAM_BANKSWITCH_ENABLE is not set
CONFIG_SPIRAM_MALLOC_ALWAYSINTERNAL=16384
CONFIG_SPIRAM_TRY_ALLOCATE_WIFI_LWIP=y
CONFIG_SPIRAM_MALLOC_RESERVE_INTERNAL=16384
# CONFIG_SPIRAM_ALLOW_STACK_EXTERNAL_MEMORY is not set
# CONFIG_SPIRAM_ALLOW_BSS_SEG_EXTERNAL_MEMORY is not set
CONFIG_D0WD_PSRAM_CLK_IO=17
CONFIG_D0WD_PSRAM_CS_IO=16
CONFIG_D2WD_PSRAM_CLK_IO=9
CONFIG_D2WD_PSRAM_CS_IO=10
CONFIG_PICO_PSRAM_CS_IO=16

CONFIG_COMPILER_OPTIMIZATION_ASSERTIONS_SILENT=y

CONFIG_ESP32_ENABLE_COREDUMP_TO_UART=y
CONFIG_ESP32_ENABLE_COREDUMP=y
CONFIG_ESP32_CORE_DUMP_MAX_TASKS_NUM=64
CONFIG_ESP32_CORE_DUMP_UART_DELAY=0
```
